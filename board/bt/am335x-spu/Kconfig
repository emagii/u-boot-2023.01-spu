## board/bt/am335x-spu/Kconfig
```kconfig
if TARGET_AM335X_SPU

config SYS_BOARD
	default "am335x-spu"

config SYS_VENDOR
	default "bt"

config SYS_SOC
	default "am33xx"

config SYS_CONFIG_NAME
	default "am335x_spu"

config BOARD_REV
	string "board revision"
	default	"0.1"

config BOARD_SERIAL
	string "board serial number"
	default "007"

source "board/bt/common/Kconfig"

endif
```

## drivers/mtd/fpga/Kconfig
```kconfig
menu "SPI FPGA Support"

config DM_SPI_FPGA
	bool "Enable Driver Model for FPGA configuration"
	depends on DM && DM_SPI
	imply SPI_FPGA
	help
	  Enable driver model for FPGAs configurable using SPI.
	  This SPI FPGA interface
	  (spi_fpga_probe(), spi_fpga_write(), etc.) is then
	  implemented by the SPI FPGA uclass.
	  There is one standard SPI FPGA driver which knows how to probe
	  chips supported by U-Boot. The uclass interface is defined in
	  include/spi_fpga.h
	  SPI and SPI FPGA must be enabled together
	  (it is not possible to use driver model for one and not the other).

if DM_SPI_FPGA

config SPI_FPGA_MTD
	bool "SPI FPGA MTD support"
	depends on MTD
	help
	  Enable the MTD support for the FPGA SPI Passive Serial,
	  This allows mtd_write commands to load an FPGA using passive serial
	  If unsure, say N

config SPI_FPGA_INTEL
	bool "Intel/Altera FPGA Passive Serial configuration using SPI"
	help
	  Add support for various Intel SPI FPGA chips

config SPI_FPGA_XILINX
	bool "Xilinx FPGA Passive Serial configuration using SPI"
	help
	  Add support for various Xilinx FPGA chips

config SPI_FPGA_CYCLONE10
	bool "Cyclone 10 SPI FPGA MTD support"
	depends on SPI_FPGA_MTD && SPI_FPGA_INTEL
	help
	  Enable the MTD support for the Cyclone 10 FPGA
	  If unsure, say N

endif

endmenu # menu "SPI FPGA Support"
```
